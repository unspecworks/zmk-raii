## boards/shields/raii/Kconfig.defconfig
```kconfig
if SHIELD_RAII_LEFT

config ZMK_KEYBOARD_NAME
    default "RAII"

config ZMK_SPLIT_ROLE_CENTRAL
    default y

config ZMK_USB
    default y

endif

if SHIELD_RAII_LEFT || SHIELD_RAII_RIGHT


config ZMK_SPLIT
    default y

if ZMK_BACKLIGHT

config PWM
    default y

config LED_PWM
    default y

endif

config ZMK_RGB_UNDERGLOW
    default y

config ZMK_EXT_POWER
    default n

config ZMK_RGB_UNDERGLOW_EXT_POWER
    default n

endif
```

## boards/shields/raii/Kconfig.shield
```kconfig
config SHIELD_RAII_LEFT
    def_bool $(shields_list_contains,raii_left)

config SHIELD_RAII_RIGHT
    def_bool $(shields_list_contains,raii_right)
```

## config/west.yml
```yaml
manifest:
  # defaults:
  #   revision: v0.3
  remotes:
    - name: zmkfirmware
      url-base: https://github.com/zmkfirmware
    - name: petejohanson
      url-base: https://github.com/petejohanson
  projects:
    - name: zmk
      remote: petejohanson
      import: app/west.yml
      revision: core/move-to-zephyr-4-1
  self:
    path: config
```
