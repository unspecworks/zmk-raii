#include "raii.dtsi"


&kscan0 {
    input-gpios
    = <&gpio0 18 (GPIO_ACTIVE_LOW | GPIO_PULL_UP)>
    , <&gpio0 13 (GPIO_ACTIVE_LOW | GPIO_PULL_UP)>
    , <&gpio0 12 (GPIO_ACTIVE_LOW | GPIO_PULL_UP)>
    , <&gpio0 24 (GPIO_ACTIVE_LOW | GPIO_PULL_UP)>
    , <&gpio0 22 (GPIO_ACTIVE_LOW | GPIO_PULL_UP)>
    , <&gpio0 16 (GPIO_ACTIVE_LOW | GPIO_PULL_UP)>
    , <&gpio0 14 (GPIO_ACTIVE_LOW | GPIO_PULL_UP)>
    , <&gpio0 10 (GPIO_ACTIVE_LOW | GPIO_PULL_UP)>
    , <&gpio0 25 (GPIO_ACTIVE_LOW | GPIO_PULL_UP)>
    , <&gpio0 21 (GPIO_ACTIVE_LOW | GPIO_PULL_UP)>
    , <&gpio0 17 (GPIO_ACTIVE_LOW | GPIO_PULL_UP)>
    , <&gpio0 15 (GPIO_ACTIVE_LOW | GPIO_PULL_UP)>
    , <&gpio0 11 (GPIO_ACTIVE_LOW | GPIO_PULL_UP)>
    , <&gpio0 9 (GPIO_ACTIVE_LOW | GPIO_PULL_UP)>
    , <&gpio0 23 (GPIO_ACTIVE_LOW | GPIO_PULL_UP)>
    , <&gpio0 19 (GPIO_ACTIVE_LOW | GPIO_PULL_UP)>
    , <&gpio0 20 (GPIO_ACTIVE_LOW | GPIO_PULL_UP)>
    ;
};
